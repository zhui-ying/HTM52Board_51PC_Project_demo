/********************************* 深圳市航太电子有限公司 *******************************
* 实 验 名 ：温度传感器下位机实验
* 实验说明 ：根据modbus协议，实时同步数据到上位机
* 实验平台 ：航太51单片机开发板 V1.1
* 连接方式 ：
* 注    意 ：
* 作    者 ：航太电子产品研发部    QQ ：1909197536
* 店    铺 ：http://shop120013844.taobao.com/
****************************************************************************************/
#include "REG52.H"
#include "system.h"
#include "modbusRTU.h"
#include <string.h>
#include <stdio.h>

#define uchar unsigned char
#define uint unsigned int
#define FOSC 11059200L //晶振设置，默认使用11.0592M Hz
//#define FOSC 12000000L //晶振设置，使用12M Hz
//#define FOSC 24000000L //晶振设置，使用24M Hz
#define TIME_US 50 //设定定时时间 us 

sbit PWM=P0^4;
sbit RS = P3^5;
sbit RW = P3^6;

int timer1=0,speed=30,motor_flag=0; 

void Timer2Init();

/*******************************************************************************
* 函 数 名 ：main
* 函数功能 ：主函数
* 输    入 ：无
* 输    出 ：无
*******************************************************************************/
void main()
{
	int i=0;
	RS = 1;
	RW = 0;
	 SystemInit();
	 init_MODBUS();
	
	Timer2Init();

	while(1)
	{				
				//将需要交互的数据读取到公共区
			  /*start*/
		 speed = modbus_Addt.motor_spped;
		 motor_flag = modbus_Addt.motor_flag;
		if(motor_flag == 0)
		{
			TR2 = 0;//停止定时器2
			PWM = 0;//关闭电机输出
		}
		else
		{
			TR2 = 1;
		}
			  /*end*/
		 	//同步公共区数据到实际运行效果
			  /*start*/

			  /*end*/
	}
}

/*******************************************************************************
* 函 数 名 ：Timer0Int
* 函数功能 ：定时器0中断函数 ， 每隔TIME_US ms进入
* 输    入 ：无
* 输    出 ：无
*******************************************************************************/
void Timer2Int() interrupt 5
{
//	TH2=(65536-(FOSC/12*TIME_US)/1000000)/256;
//	TL2=(65536-(FOSC/12*TIME_US)/1000000)%256;
	TF2 = 0;
	timer1++;  
	if(timer1>100)  //PWM周期为100*0.05ms
	{
		timer1=0;
	}
	if(timer1 < speed)	//改变30这个值可以改变直流电机的速度
	{
		PWM=1;
	}
	else
	{
		PWM=0;
	}  
}

/*******************************************************************************
* 函 数 名 ：Timer1Init
* 函数功能 ：定时器1初始化
* 输    入 ：无
* 输    出 ：无
*******************************************************************************/
void Timer2Init()
{
	RCAP2H=TH2=(65536-(FOSC/12*TIME_US)/1000000)/256;
	RCAP2L=TL2=(65536-(FOSC/12*TIME_US)/1000000)%256;
	ET2=1; //开启定时器0中断
	TR2=1;	//开启定时器	
	EA=1;  //打开总中断
}



